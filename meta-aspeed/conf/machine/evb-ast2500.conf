## meta-aspeed/conf/machine/evb-ast2500.conf
```bitbake
KERNEL_DEVICETREE = "aspeed/aspeed-ast2500-evb.dtb"

# The default configuration file for u-boot-2016.07 may be ast_g5_phy_config,
# if evb-ast2500_defconfig is not available.
UBOOT_MACHINE = "ast_g5_phy_config"
UBOOT_DEVICETREE = "ast2500-evb"

require conf/machine/include/ast2500.inc
require conf/machine/include/obmc-evb-common.inc

SERIAL_CONSOLES = "115200;ttyS4"

FLASH_SIZE = "65536"
```
